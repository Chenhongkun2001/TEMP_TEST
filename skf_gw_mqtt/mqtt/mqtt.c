#include "MQTTClient.h"
#include "auxiliar.h"
#include "global.h"
// #include "jsonbuild.h"
#include "string.h"
#include "upmsg.h"
#include "DeviceAppBulletGateway.pb.h"
#include "datawrap.h"
#include "http.h"
#include "ipcmbs.h"
// #include <math.h>
#include "mqtt.h"
#include "pb_decode.h"
#include "ppGW.h"
#include <semaphore.h>
// #include <signal.h>
#include <hash.h>
#include <stdbool.h>
#include <stdint.h>
#include <stdio.h>
#include <termios.h>
#include <thread_waitmsg.h>
#include <unistd.h>

// LED
#include "app_io.h"

// LTE
#include "app_lte.h"
DBG_LOCAL_LOG_DEBUG

// #define FIXED_TOPIC
// #define FROTO_DECODER_DEBUG
#if (ENABLE_MODBUS_FEATURE == 1)
#include "gwConfig.h"
extern uint32_t g_dev_nameid_list[GW_MAX_CHILDREN_NUM];
extern uint8_t g_dev_cnt;
#endif

MQTTClient client = NULL;
static MQTTClient_connectOptions conn_opts =
    MQTTClient_connectOptions_initializer;
static MQTTClient_deliveryToken token = 0;
static MQTTClient_message *receivemsg = NULL;
static char *topicName_rev = NULL;
static int topicLen_rev = 0;
static int rc = 0;
extern char rev_msgbuf[4096];
char device_id[32] = {0};
uint8_t sensor_id[32] = {0};
uint8_t measure_type[SENSOR_DATA_NUM] = {0};
char topic_buffer[200] = {0};
peer_addr_t peer_addr = {0};
uint8_t mqtt_topic[MQTT_TOPIC_LEN] = {0};
check_value_t local_check_value = {0};
uint8_t ota_url[OTA_URL_ADDR_LEN] = {0};
uint8_t up_url[OTA_URL_ADDR_LEN] = {0};
uint8_t acked_message_seq_no[5] = {0};
firmware_package_info_t update_package_info = {0};
firmware_package_info_t current_package_info = {0};
extern SKFChina_App_AppMessage SKF_BullGateway;
// extern SKFChina_App_AppMessage SKF_BullGateway_tx;
static SKFChina_Froto_FrotoHeader *Froto_header;
extern uint32_t sensor_firmware_version;
char mqtt_addr[100] = {0};
char clientID[50] = {0};
char topic_clientID[50] = {0};
char topic_device_type[50] = GATAWAY_NAME;
sem_t sem = {0};
extern sem_t updatasem;
static char subtopic[SUB_TOPIC_NUM][200] = {0};
static char *subtopicptr[SUB_TOPIC_NUM] = {NULL};
static int subtopicqos[SUB_TOPIC_NUM] = {0};
char upfilename[100];
static gw_pro_sqlite_cond_element_t
    filterData[GW_PRO_MAX_DATA_FIELD_PER_OPERATION] = {0};
static gw_pro_command_sqlite_filter_response_t filter_rx = {0};
bool mqtt_isConnected = false;
static uint8_t sen_time = 0;
static struct msgbuf msgbufp = {0};
static gw_pro_message_header_t *pdata =
    (gw_pro_message_header_t *)msgbufp.mtext;
extern gw_pro_data_t middle_data[SENSOR_DATA_NUM];
char firmname[100] = {0};
bool reporting_data_flag = false;

// Auto-route: when the network is not good, 
// the gateway would try another network (e.g., switch from ethernet to LTE)
static uint32_t disconnectCnt = 0;
static uint32_t networkToggleCooldown = 0;

#define MQTT_RETRY_BASE_DELAY_S 2U
#define MQTT_RETRY_MAX_DELAY_S 60U
#define MQTT_RETRY_BACKOFF_STEP 5U
#define MQTT_TOGGLE_THRESHOLD 10U
#define MQTT_TOGGLE_COOLDOWN_ATTEMPTS 30U

// char *downargs[MAX_DOWNLOAD_ARGS] = {"curl", "-X GET", (char *)ota_url, "-o",
//                                      firmname};
// // char *downargs[MAX_DOWNLOAD_ARGS] = {"curl", "-O", (char *)ota_url};
// char *upargs[MAX_UPLOAD_ARGS] = {"curl", "-H", "\"Authorization:token\"",
//                                  "-F",   upfilename, (char *)up_url};

static void mqtt_data_parse(char *topic, uint8_t *buffer, uint32_t size);
static int send_data_to_peer(pb_size_t which_msg,
                             SKFChina_Froto_FrotoPmtType type);
static void construct_topic(char *clientID);
static unsigned int mqtt_get_retry_delay(uint32_t failure_count);
static void mqtt_handle_connect_failure(int error_code, bool need_sleep);

static unsigned int mqtt_get_retry_delay(uint32_t failure_count) {
  unsigned int retry_delay = MQTT_RETRY_BASE_DELAY_S;
  uint32_t backoff_step = failure_count / MQTT_RETRY_BACKOFF_STEP;

  while (backoff_step-- > 0 && retry_delay < MQTT_RETRY_MAX_DELAY_S) {
    if (retry_delay > (MQTT_RETRY_MAX_DELAY_S / 2U)) {
      retry_delay = MQTT_RETRY_MAX_DELAY_S;
      break;
    }
    retry_delay *= 2U;
  }
  return retry_delay;
}

static void mqtt_handle_connect_failure(int error_code, bool need_sleep) {
  unsigned int retry_delay = 0;

  app_io_post_led_event(LED_EV_MQTT_ERR);
  if (disconnectCnt < UINT32_MAX) {
    disconnectCnt++;
  }
  if (networkToggleCooldown > 0) {
    networkToggleCooldown--;
  }

  retry_delay = mqtt_get_retry_delay(disconnectCnt);
  LOG_WARN(OUTPOINT,
           "MQTT reconnect failed:%d streak:%u retry in %u s cooldown:%u\r\n",
           error_code, disconnectCnt, retry_delay, networkToggleCooldown);

  if (disconnectCnt >= MQTT_TOGGLE_THRESHOLD) {
    if (networkToggleCooldown == 0) {
      LOG_WARN(OUTPOINT, "MQTT reconnect threshold reached, toggle network\r\n");
      toggleNetwork();
      networkToggleCooldown = MQTT_TOGGLE_COOLDOWN_ATTEMPTS;
    } else {
      LOG_WARN(OUTPOINT,
               "MQTT reconnect threshold reached, skip toggle during cooldown\r\n");
    }
    disconnectCnt = 0;
    retry_delay = MQTT_RETRY_BASE_DELAY_S;
  }

  if (need_sleep) {
    sleep(retry_delay);
  }
}

int mqtt_send(MQTTClient_message *pubmsg, char *send_topic) {
  if (client == NULL) {
    return MQTTCLIENT_FAILURE;
  }
  // reconnect and subcribe if the status is not connected
  if (!MQTTClient_isConnected(client)) {
    LOG_WARN(OUTPOINT, "The network is not conected,Failed to send msg!\r\n");
    return MQTTCLIENT_FAILURE;
  }
  rc = MQTTClient_publishMessage(client, send_topic, pubmsg, &token);
  if (MQTTCLIENT_SUCCESS != rc)
    return rc;
  LOG_INFO(OUTPOINT,
           "Waiting for up to %d seconds for publication of %d"
           "on topic %s for client with ClientID: %s\n",
           (int)(SEND_TIMEOUT / 1000), rc, send_topic,
           send_topic); // PUBLISH_TOPIC
  rc = MQTTClient_waitForCompletion(client, token, SEND_TIMEOUT);
  if (MQTTCLIENT_SUCCESS != rc) {
    LOG_INFO(OUTPOINT, "send faile code:%d\r\n", rc);
    sen_time++;
    if (sen_time >= MAX_SEND_TIME) {
      mqtt_isConnected = false;
      sen_time = 0;
      LOG_INFO(OUTPOINT, "disconnect:%d\r\n",
               MQTTClient_disconnect(client, REV_TIMEOUT));
    }
    return rc;
  }
  LOG_INFO(OUTPOINT, "Message with delivery token %d delivered\n", token);
  return rc;
}

#ifdef FROTO_DECODER_DEBUG
#if 0
const uint8_t recv_msg_debug[] =
{ 0x22, 0x6c, 0x0a, 0x2e, 0x08, 0x01, 0x12, 0x0c, 0x43, 0x34, 0x42, 0x44,
  0x36, 0x41, 0x31, 0x32, 0x30, 0x30, 0x33, 0x33, 0x1a, 0x18, 0x68, 0x74,
  0x74, 0x70, 0x73, 0x3a, 0x2f, 0x2f, 0x64, 0x70, 0x2d, 0x75, 0x61, 0x74,
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  0x70, 0x63 };
#elif 0
const uint8_t recv_msg_debug[] =
{ 0x08, 0x01, 0x3a, 0xa5, 0x17, 0x0a, 0x24, 0x08, 0x01, 0x12, 0x0c, 0x43,
  0x34, 0x42, 0x44, 0x36, 0x41, 0x31, 0x32, 0x30, 0x30, 0x33, 0x33, 0x30,
  0x00, 0x38, 0xc6, 0xea, 0xde, 0xbb, 0x06, 0x40, 0x01, 0x48, 0x03, 0x50,
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  0x42, 0x44, 0x36, 0x41, 0x31, 0x31, 0x30, 0x30, 0x35, 0x39 };
#elif 0
const uint8_t recv_msg_debug[] =
{ 0x08, 0x01, 0x3a, 0x80, 0x02, 0x0a, 0x24, 0x08, 0x01, 0x12, 0x0c, 0x43,
  0x34, 0x42, 0x44, 0x36, 0x41, 0x31, 0x32, 0x30, 0x30, 0x33, 0x33, 0x30,
  0x00, 0x38, 0xe1, 0xf5, 0xd8, 0xbb, 0x06, 0x40, 0x01, 0x48, 0x03, 0x50,
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  0x2e, 0x31, 0x37, 0x38, 0x2e, 0x36, 0x32, 0x2e, 0x31 };
#elif 0
const uint8_t recv_msg_debug[] =
{ 0x08, 0x01, 0x3a, 0xd9, 0x04, 0x0a, 0x24, 0x08, 0x01, 0x12, 0x0c, 0x43,
  0x34, 0x42, 0x44, 0x36, 0x41, 0x31, 0x31, 0x30, 0x30, 0x35, 0x35, 0x30,
  0x00, 0x38, 0x99, 0xf8, 0xd8, 0xbb, 0x06, 0x40, 0x01, 0x48, 0x03, 0x50,
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  0x00, 0x00, 0x00, 0x00, 0x50, 0x71 };
#elif 0
const uint8_t recv_msg_debug[] =
{ 0x08, 0x01, 0x3a, 0xcd, 0x02, 0x0a, 0x24, 0x08, 0x01, 0x12, 0x0c, 0x43,
  0x34, 0x42, 0x44, 0x36, 0x41, 0x31, 0x31, 0x30, 0x30, 0x35, 0x35, 0x30,
  0x00, 0x38, 0x9a, 0xf8, 0xd8, 0xbb, 0x06, 0x40, 0x01, 0x48, 0x03, 0x50,
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  0x95, 0x01 };
#endif
#endif /* FROTO_DECODER_DEBUG */

// MQTTCLIENT_SUCCESS
int mqtt_task() {
  uint8_t testnum = 3;
  uint8_t index = strlen(clientID);
  char *token = NULL;
  char tmpcmpstr[50] = {0};
  char mqtt_password[50] = MQTT_PASSWORD;
  char mqtt_username[50] = MQTT_USERNAME;
  uint32_t refresh_cnt = 0;
  bool is_sensor_topic = false;
#if defined(TEST_MAC)
  snprintf(clientID, sizeof(clientID) - 1, "%s", CLIENTID);
#endif
  Gain_passwd(clientID, mqtt_password, sizeof(mqtt_password) - 1);
  conn_opts.keepAliveInterval = 20;
  conn_opts.cleansession = 1;
  // conn_opts.connectTimeout = 10;
  conn_opts.username = mqtt_username;
  conn_opts.password = mqtt_password;
  LOG_INFO(OUTPOINT, "mqtt start:\r\n");
  LOG_INFO(OUTPOINT, "user:%s\r\n", conn_opts.username);
  LOG_INFO(OUTPOINT, "pawd:%s\r\n", conn_opts.password);
  LOG_INFO(OUTPOINT, "mqtt server:%s\r\n", mqtt_addr);
  LOG_INFO(OUTPOINT, "cid:%s\r\n", clientID);
  sem_init(&sem, 0, 1);

#ifdef FROTO_DECODER_DEBUG // Just for debug
  mqtt_data_parse(topicName_rev, (uint8_t *)recv_msg_debug,
                    sizeof(recv_msg_debug));
  exit(1);
#endif /* FROTO_DECODER_DEBUG */

  // Create the connect of mqtt
  MQTTClient_create(&client, mqtt_addr, clientID, MQTTCLIENT_PERSISTENCE_NONE,
                    NULL);
  if ((rc = MQTTClient_connect(client, &conn_opts)) != MQTTCLIENT_SUCCESS) {
    mqtt_handle_connect_failure(rc, false);
  }

  // sleep(2);
  // send lastedittime to cloud
  while (testnum--) {
    if (MQTTClient_isConnected(client)) {
      // up_edit_time();
      break;
    }
    sleep(2);
  }

  // subscribe the topic
#ifdef FIXED_TOPIC
  MQTTClient_subscribe(client, SUBSCRIBE_TOPIC, mqtt_qos_two);
#else
  construct_topic(clientID);
  for (uint8_t i = 0; i < SUB_TOPIC_NUM; i++) {
    LOG_INFO(OUTPOINT, "topic[%d]:%s\r\n", i, subtopicptr[i]);
  }
  // subscribe many topics
  LOG_INFO(OUTPOINT, "sub_res:%d\r\n",
           MQTTClient_subscribeMany(client, SUB_TOPIC_NUM, subtopicptr,
                                    subtopicqos));

  mqtt_isConnected = true;
  // up_edit_time();
#endif
  while (1) {
    is_sensor_topic = false;
    memset(tmpcmpstr, 0, sizeof(tmpcmpstr));
    // reconnect and subcribe if the status is not connected
    if (!MQTTClient_isConnected(client)) {
      mqtt_isConnected = false;
      if (MQTTCLIENT_SUCCESS != (rc = MQTTClient_connect(client, &conn_opts))) {
        mqtt_handle_connect_failure(rc, true);
        continue;
      }
#ifdef FIXED_TOPIC
      MQTTClient_subscribe(client, SUBSCRIBE_TOPIC, mqtt_qos_two);
#else
      construct_topic(clientID); // Must construct the topic again (hmm, perhaps 
                                 // there is memory leakage ...)
      LOG_INFO(OUTPOINT, "sub_res:%d\r\n",
               MQTTClient_subscribeMany(client, SUB_TOPIC_NUM, subtopicptr,
                                        subtopicqos));
#endif
    }
    mqtt_isConnected = true;
    app_io_post_led_event( LED_EV_MQTT_ERR_RL );
    disconnectCnt = 0;
    // try to receive the message
    if (MQTTCLIENT_SUCCESS !=
            (rc = MQTTClient_receive(client, &topicName_rev, &topicLen_rev,
                                     &receivemsg, REV_TIMEOUT)) ||
        topicName_rev == NULL) {
      if (receivemsg != NULL) {
        MQTTClient_freeMessage(&receivemsg);
        receivemsg = NULL;
      }
      if (topicName_rev != NULL) {
        MQTTClient_free(topicName_rev);
        topicName_rev = NULL;
        LOG_WARN(OUTPOINT, "No valid data from the subscribe topic!\r\n");
      } else {
        LOG_INFO(OUTPOINT, "Heart beat %d %d\r\n", rc, refresh_cnt);
        // NB: Force to refresh (i.e., disconnect and connect) the broker
        if(refresh_cnt++ >= 3600)
        {
          refresh_cnt = 0;
          LOG_INFO(OUTPOINT, "Refresh mqtt connection");
          MQTTClient_disconnect(client, REV_TIMEOUT);
        }
      }
      continue;
    }
    size_t payload_len = receivemsg->payloadlen;

    LOG_INFO(OUTPOINT, "Message REv %d bytes.\r\n", receivemsg->payloadlen);
    // LOG_INFO(OUTPOINT, "len:%d,topicName:%s\r\n", topicLen_rev,
    // topicName_rev);
    LOG_INFO(OUTPOINT, "rev_msg:");
    if (payload_len >= sizeof(rev_msgbuf)) {
      payload_len = sizeof(rev_msgbuf) - 1;
      LOG_WARN(OUTPOINT, "payload too large, truncating!len:%d\r\n", payload_len);
    }
    memcpy(rev_msgbuf, receivemsg->payload, payload_len);
    rev_msgbuf[payload_len] = '\0';
    for (size_t i = 0; i < payload_len; i++) {
      printf("%02x ", rev_msgbuf[i]);
    }
    printf("\r\n");
    token = strrchr(topicName_rev, '/');
    if (token == NULL) {
      LOG_WARN(OUTPOINT, "Invalid topic without separator\r\n");
      goto mqtt_msg_cleanup;
    }
    snprintf(topic_clientID, sizeof(topic_clientID), "%s", token + 1);
    if (!strstr(topicName_rev, clientID) || !strlen(topic_clientID)) {
      goto mqtt_msg_cleanup;
    }
    if (strstr(topicName_rev, SENSOR_NAME)) {
      if ((size_t)(token - topicName_rev) < index) {
        LOG_WARN(OUTPOINT, "Invalid sensor topic for client compare\r\n");
        goto mqtt_msg_cleanup;
      }
      snprintf(topic_device_type, sizeof(topic_device_type) - 1, "%s",
               SENSOR_NAME);
      snprintf(tmpcmpstr, sizeof(tmpcmpstr), "%.*s", (int)index,
               token - index);
      is_sensor_topic = true;
      if (strcmp(tmpcmpstr, clientID))
        goto mqtt_msg_cleanup;
    } else if (strstr(topicName_rev, GATAWAY_NAME)) {
      snprintf(topic_device_type, sizeof(topic_device_type) - 1, "%s",
               GATAWAY_NAME);
      if (strcmp(topic_clientID, clientID))
        goto mqtt_msg_cleanup;
    } else {
      LOG_WARN(OUTPOINT, "Invalid topic for me\r\n");
      goto mqtt_msg_cleanup;
    }
    LOG_DEBUG(OUTPOINT, "id:%s\r\n", topic_clientID);

    snprintf(device_id, sizeof(device_id) - 1, "%s", topic_clientID);
    if (!is_sensor_topic) {
      snprintf(topic_device_type, sizeof(topic_device_type) - 1, "%s",
               GATAWAY_NAME);
    } else {
      snprintf(topic_device_type, sizeof(topic_device_type) - 1, "%s",
               SENSOR_NAME);
      snprintf(topic_clientID, sizeof(topic_clientID) - 1, "%s", device_id);
    }

    LOG_INFO(OUTPOINT, "pubinfo:%s,%s\n", topic_device_type, device_id);
    mqtt_data_parse(topicName_rev, (uint8_t *)rev_msgbuf,
                    receivemsg->payloadlen);
  mqtt_msg_cleanup:
    MQTTClient_freeMessage(&receivemsg);
    MQTTClient_free(topicName_rev);
    receivemsg = NULL;
    topicName_rev = NULL;
  }
  MQTTClient_disconnect(client, REV_TIMEOUT);
  MQTTClient_destroy(&client);
  return 0;
}

static void mqtt_data_parse(char *topic, uint8_t *buffer, uint32_t size) {
  pb_istream_t istream = pb_istream_from_buffer(buffer, size);
  memset((void *)&SKF_BullGateway, 0, sizeof(SKF_BullGateway));
  pb_decode(&istream, SKFChina_App_AppMessage_fields, &SKF_BullGateway);
  istream = pb_istream_from_buffer(buffer, size);
  switch (SKF_BullGateway.which__messages) {
    //
  case SKFChina_App_AppMessage_data_selection_tag: {
    Froto_header = &(SKF_BullGateway._messages.data_selection.header);
  } break;
  //
  case SKFChina_App_AppMessage_config_retrieve_tag: {
    Froto_header = &(SKF_BullGateway._messages.config_retrieve.header);
  } break;
  case SKFChina_App_AppMessage_config_dissem_tag: {
    Froto_header = &(SKF_BullGateway._messages.config_dissem.header);
  } break;
  //
  case SKFChina_App_AppMessage_command_dissem_tag: {
    Froto_header = &(SKF_BullGateway._messages.command_dissem.header);
  } break;
  //
  case SKFChina_App_AppMessage_file_notify_dissem_tag: {
    Froto_header = &(SKF_BullGateway._messages.command_dissem.header);
  } break;
  //
  case SKFChina_App_AppMessage_version_retrieve_tag: {
    Froto_header = &(SKF_BullGateway._messages.version_retrieve.header);
  } break;
  case SKFChina_App_AppMessage_last_fuota_upload_tag: {
    Froto_header = &(SKF_BullGateway._messages.last_fuota_upload.header);
  } break;
  //
  case SKFChina_App_AppMessage_fuota_notify_dissem_tag: {
    Froto_header = &(SKF_BullGateway._messages.fuota_notify_dissem.header);
    sensor_firmware_version =
        SKF_BullGateway._messages.fuota_notify_dissem.firmware_version;
  } break;
  case SKFChina_App_AppMessage_image_block_dissem_tag: {
    Froto_header = &(SKF_BullGateway._messages.image_block_dissem.header);
  } break;
  case SKFChina_App_AppMessage_ack_tag: {
    Froto_header = &(SKF_BullGateway._messages.ack.header);
  } break;
  case SKFChina_App_AppMessage_debug_message_tag: {
    Froto_header = &(SKF_BullGateway._messages.debug_message.header);
  } break;

  default:
    break;
  }
  decode_froto_header(&istream, Froto_header, sensor_id, sizeof(sensor_id),
                      peer_addr.cloud_url, sizeof(peer_addr.cloud_url),
                      acked_message_seq_no, sizeof(acked_message_seq_no));

  istream = pb_istream_from_buffer(buffer, size);

  if (Froto_header->is_up) {
    LOG_WARN(OUTPOINT, "This is not the down message!\r\n");
    return;
  }
  LOG_INFO(OUTPOINT, "sensor id:%s\r\n", sensor_id);
  // if (0 != strncmp(device_id, sensor_id, strlen(device_id))) {
  //   LOG_WARN(OUTPOINT, "Not my sensor id\r\n");
  //   return;
  // }
  if ((Froto_header->has_is_big_endian) && (Froto_header->is_big_endian)) {
    Froto_header->message_type = swap32(Froto_header->message_type);
    Froto_header->primitive_type = swap32(Froto_header->primitive_type);
  }
  // logic entry point
  switch (Froto_header->primitive_type) {
  case SKFChina_Froto_FrotoPmtType_UNKNOWN_PRIMITIVETYPE: {
    LOG_WARN(OUTPOINT, "Unknown primitive type\r\n");
  } break;
  case SKFChina_Froto_FrotoPmtType_SIMPLE_DISSEMINATE: {
    LOG_INFO(OUTPOINT, "Simple disseminate\r\n");
    LOG_INFO(OUTPOINT, "%d\r\n", SKF_BullGateway.which__messages);

    Simple_disseminate(SKF_BullGateway.which__messages, &istream);
    send_data_to_peer(SKF_BullGateway.which__messages,
                      SKFChina_Froto_FrotoPmtType_SIMPLE_UPLOAD);
  } break;
  case SKFChina_Froto_FrotoPmtType_RELIABLE_DISSEMINATE: {
    LOG_INFO(OUTPOINT, "Reliable disseminate\r\n");
    Reliable_disseminate(SKF_BullGateway.which__messages, &istream);
    send_data_to_peer(SKF_BullGateway.which__messages,
                      SKFChina_Froto_FrotoPmtType_SIMPLE_UPLOAD);
  } break;
  case SKFChina_Froto_FrotoPmtType_SIMPLE_BULK_DISSEMINATE: {
    LOG_INFO(OUTPOINT, "Simple bulk disseminate\r\n");
  } break;
  case SKFChina_Froto_FrotoPmtType_RELIABLE_BULK_DISSEMINATE: {
    LOG_INFO(OUTPOINT, "Reliable bulk disseminate\r\n");
  } break;
  case SKFChina_Froto_FrotoPmtType_SIMPLE_RETRIVE: {
    LOG_INFO(OUTPOINT, "Simpleretrive\r\n");
    // Simple_retrive(SKF_BullGateway.which__messages, &istream);
    // send_data_to_peer(SKF_BullGateway.which__messages,
    //                   SKFChina_Froto_FrotoPmtType_SIMPLE_UPLOAD);
  } break;

  default:
    break;
  }
}

static int send_data_to_peer(pb_size_t which_msg,
                             SKFChina_Froto_FrotoPmtType type) {
  char temp[100] = {0};
  uint32_t tempid = 0;
  char local_topic[200] = {0};
  SKFChina_App_AppMessage SKF_BullGateway_tx = {0};
  memset((void *)&SKF_BullGateway_tx, 0, sizeof(SKF_BullGateway_tx));
  switch (which_msg) {
  case SKFChina_App_AppMessage_last_fuota_upload_tag: {
    snprintf(temp, sizeof(temp) - 1, "%s/%s", clientID, topic_clientID);
    COINFIG_MQTT_PUBLISH_FUOTA_TOPIC(local_topic, topic_device_type, temp);
    Simple_upload(which_msg, SKF_BullGateway_tx, local_topic, topic_clientID);
  } break;
  case SKFChina_App_AppMessage_config_retrieve_tag: {
    snprintf(temp, sizeof(temp) - 1, "%s/%s", clientID, topic_clientID);
    COINFIG_MQTT_PUBLISH_CONFIG_TOPIC(local_topic, topic_device_type, temp);
    Simple_upload(which_msg, SKF_BullGateway_tx, local_topic, topic_clientID);
  } break;
  case SKFChina_App_AppMessage_version_retrieve_tag:
  case SKFChina_App_AppMessage_data_upload_tag: {
    snprintf(temp, sizeof(temp) - 1, "%s/%s", clientID, topic_clientID);
    COINFIG_MQTT_PUBLISH_DATA_TOPIC(local_topic, topic_device_type, temp);
    Simple_upload(which_msg, SKF_BullGateway_tx, local_topic, topic_clientID);
  } break;
  case SKFChina_App_AppMessage_data_selection_tag: {
    gw_pro_command_sqlite_query_item_response_t query_data = {0};
    if (strcmp(clientID, topic_clientID)) {
      snprintf(temp, sizeof(temp) - 1, "%s/%s", clientID, topic_clientID);
      COINFIG_MQTT_PUBLISH_DATA_TOPIC(local_topic, topic_device_type, temp);
    } else {
      COINFIG_MQTT_PUBLISH_DATA_TOPIC(local_topic, topic_device_type,
                                      topic_clientID);
    }
    // set reporting_data_flag to tell wait_uplaod_timer() that report_datachange_cloud() is ongoing
    reporting_data_flag = true;
    for (uint8_t i = 0; i < SENSOR_DATA_NUM; i++) {
      if (measure_type[i] == 0)
        continue;
      // try to get the nameid from Dev table
      filterData[0].field = 11;
      filterData[0].condition = gw_pro_sqlite_cond_value_range;
      filterData[0].condParam.range_uint32.max =
          filterData[0].condParam.range_uint32.min = measure_type[i];

      filterData[1].condition = gw_pro_sqlite_cond_and;

      filterData[2].field = 4;
      filterData[2].condition = gw_pro_sqlite_cond_str_equal;
      snprintf(filterData[2].condParam.string_value.s,
               GW_PRO_MAX_STRING_LEN_BYTE - 1, "%s", topic_clientID);
      filterData[3].condition = gw_pro_sqlite_cond_and;

      filterData[4].field = 8;
      filterData[4].condition = gw_pro_sqlite_cond_value_range;
      filterData[4].condParam.range_uint64.max =
          SKF_BullGateway._messages.data_selection.sample_time_end;
      filterData[4].condParam.range_uint64.min =
          SKF_BullGateway._messages.data_selection.sample_time_start;
      if (ipc_sql_filter_item(SENSOR_DATA_TABLE, 5, filterData, &msgbufp) ||
          pdata->comRespFg == GW_PRO_COMRESPFG_COMMAND ||
          pdata->command_or_response.responseMsg.response ==
              gw_pro_response_failed ||
          pdata->command_or_response.responseMsg.responseInfo
                  .sqlite_filter_item_reponse.dataNum == 0) {
        LOG_WARN(OUTPOINT, "Failed to get datas from sensor data table\r\n");
        reporting_data_flag = false;
        return 1;
      }
      memset(&filter_rx, 0, sizeof(filter_rx));
      memcpy(&filter_rx,
             &pdata->command_or_response.responseMsg.responseInfo
                  .sqlite_filter_item_reponse,
             sizeof(gw_pro_command_sqlite_filter_response_t));
      tempid =
          findMax((int *)filter_rx.filteredItemIdx, 0, filter_rx.dataNum - 1);
      memset(&msgbufp, 0, sizeof(msgbufp));
      if (ipc_sql_query_item(SENSOR_DATA_TABLE, tempid, &msgbufp) ||
          pdata->comRespFg == GW_PRO_COMRESPFG_COMMAND ||
          pdata->command_or_response.responseMsg.response ==
              gw_pro_response_failed) {
        LOG_WARN(OUTPOINT, "Failed to get datas from sensor table\r\n");
        reporting_data_flag = false;
        return 1;
      }
      memcpy(&query_data,
             &pdata->command_or_response.responseMsg.responseInfo
                  .sqlite_update_item_response,
             sizeof(gw_pro_command_sqlite_query_item_response_t));
      report_datachange_cloud(query_data.inquiredData, query_data.dataNum);
    }
    reporting_data_flag = false;
  } break;
  case SKFChina_App_AppMessage_image_block_request_tag: {
  } break;
  case SKFChina_App_AppMessage_fuota_notify_dissem_tag:
    LOG_INFO(OUTPOINT, "from fuota!\r\n");
  case SKFChina_App_AppMessage_file_notify_dissem_tag: {
    // the path will be different based on the file type
    LOG_INFO(OUTPOINT, "send to download file!\r\n");
    enable_http_task(MAX_DOWNLOAD_ARGS);
    sleep(1);
  } break;
  default:
    break;
  }
  return 0;
}

void up_edit_time() {
  gw_pro_command_sqlite_query_item_response_t query_response = {0};
  char temp[100] = {0};
  uint32_t hash = 0;
  char local_topic[200] = {0};
  char local_devid[32] = {0};
  uint8_t product = 0;
  SKFChina_App_AppMessage SKF_BullGateway_tx = {0};
  memset(&msgbufp, 0, sizeof(msgbufp));
  if (ipc_sql_query_item(GATEWAY_CONFIGURE_TABLE, 0, &msgbufp) ||
      pdata->comRespFg == GW_PRO_COMRESPFG_COMMAND ||
      pdata->command_or_response.responseMsg.response ==
          gw_pro_response_failed) {
    LOG_WARN(OUTPOINT, "Failed to get datas from gateway table\r\n");
    return;
  }
  memset((void *)&SKF_BullGateway_tx, 0, sizeof(SKF_BullGateway_tx));
  for (uint8_t i = 0; i < pdata->command_or_response.responseMsg.responseInfo
                              .sqlite_update_item_response.dataNum;
       i++) {
    switch (pdata->command_or_response.responseMsg.responseInfo
                .sqlite_update_item_response.inquiredData[i]
                .field) {
    case 8: {
      SKF_BullGateway_tx._messages.config_hash_upload.last_edit_time.time =
          pdata->command_or_response.responseMsg.responseInfo
              .sqlite_update_item_response.inquiredData[i]
              .data.data_uint64;
    } break;
    default:
      break;
    }
  }
#if (GW_PRO == 1)
  SKF_BullGateway_tx._messages.config_hash_upload.product =
      SKFChina_Common_ProductType_BULLET_GATEWAY_PRO;
#else
  SKF_BullGateway_tx._messages.config_hash_upload.product =
      SKFChina_Common_ProductType_BULLET_GATEWAY;
#endif
  COINFIG_MQTT_PUBLISH_CONFIG_TOPIC(local_topic, GATAWAY_NAME, clientID);
  Simple_upload(SKFChina_App_AppMessage_config_hash_upload_tag,
                SKF_BullGateway_tx, local_topic, clientID);
  // sensor part
  filterData[0].condition = gw_pro_sqlite_cond_all;
  filterData[0].field = 1;
  memset(&msgbufp, 0, sizeof(msgbufp));
  if (ipc_sql_filter_item(DEVICE_LIST_TABLE, 1, filterData, &msgbufp) ||
      pdata->comRespFg == GW_PRO_COMRESPFG_COMMAND ||
      pdata->command_or_response.responseMsg.response ==
          gw_pro_response_failed) {
    LOG_WARN(OUTPOINT, "Failed to get datas from Dev table\r\n");
    return;
  }
  memset(&filter_rx, 0, sizeof(filter_rx));
  memcpy(&filter_rx,
         &pdata->command_or_response.responseMsg.responseInfo
              .sqlite_filter_item_reponse,
         sizeof(gw_pro_command_sqlite_filter_response_t));
#if (ENABLE_MODBUS_FEATURE == 1)
    g_dev_cnt = filter_rx.dataNum;
    memset(&g_dev_nameid_list, 0, sizeof(g_dev_nameid_list));
    for (uint16_t i = 0; i < filter_rx.dataNum; i++) {
      g_dev_nameid_list[i] = filter_rx.filteredItemIdx[i];
    }
    // sleep(2);
    // LOG_INFO(OUTPOINT, "shm:dev_list_num:%d\r\n",g_dev_cnt);
#endif

  for (uint16_t i = 0; i < filter_rx.dataNum; i++) {
    memset(&msgbufp, 0, sizeof(msgbufp));
    if (ipc_sql_query_item(SENSOR_CONFIGURE_TABLE, filter_rx.filteredItemIdx[i],
                           &msgbufp) ||
        pdata->comRespFg == GW_PRO_COMRESPFG_COMMAND ||
        pdata->command_or_response.responseMsg.response ==
            gw_pro_response_failed) {
      LOG_WARN(OUTPOINT, "Failed to get datas from sensor table\r\n");
      continue;
    }
    if (pdata->command_or_response.responseMsg.responseInfo
            .sqlite_update_item_response.dataNum == 0) {
      LOG_WARN(OUTPOINT, "No datas from sensor table when the nameID is %d\r\n",
               filter_rx.filteredItemIdx[i]);
      if (ipc_sql_query_item(DEVICE_LIST_TABLE, filter_rx.filteredItemIdx[i],
                             &msgbufp) ||
          pdata->comRespFg == GW_PRO_COMRESPFG_COMMAND ||
          pdata->command_or_response.responseMsg.response ==
              gw_pro_response_failed) {
        LOG_WARN(OUTPOINT, "Failed to get datas from Dev table\r\n");
        continue;
      }
      memset(&query_response, 0, sizeof(query_response));
      memcpy(&query_response,
             &pdata->command_or_response.responseMsg.responseInfo
                  .sqlite_update_item_response,
             sizeof(gw_pro_command_sqlite_query_item_response_t));
      for (uint8_t i = 0; i < query_response.dataNum; i++) {
        switch (query_response.inquiredData[i].field) {
        case 4: {
          LOG_DEBUG(OUTPOINT, "mac:%s\r\n",
                    query_response.inquiredData[i].data.data_char);
          snprintf(temp, sizeof(temp) - 1, "%s/%s", clientID,
                   query_response.inquiredData[i].data.data_char);
          snprintf(device_id, sizeof(device_id) - 1, "%s",
                   query_response.inquiredData[i].data.data_char);
          // snprintf(topic_clientID, sizeof(topic_clientID) - 1, "%s",
          // "C4BD6A123459");
        } break;
        case 11: {
          LOG_DEBUG(OUTPOINT, "type:%s\r\n",
                    query_response.inquiredData[i].data.data_char);
          if (strcmp("PredictSensor", query_response.inquiredData[i].data.data_char))
          {
            product = SKFChina_Common_ProductType_BULLET_NODE;
          }else{
            if (strcmp("PredictSensorPro", query_response.inquiredData[i].data.data_char))
            {
              product = SKFChina_Common_ProductType_BULLET_NODE_PRO;
            }else{
              if (strcmp("Insight-T", query_response.inquiredData[i].data.data_char))
              {
                product = SKFChina_Common_ProductType_INSIGHT_T;
              }else{
                product = SKFChina_Common_ProductType_UNKNOWN_PRODUCT;
              }
            }
          }
        } break;
        default:
          break;
        }
      }
      hash = -1;
      goto hash_upload;
    }
    memset(&query_response, 0, sizeof(query_response));
    memcpy(&query_response,
           &pdata->command_or_response.responseMsg.responseInfo
                .sqlite_update_item_response,
           sizeof(gw_pro_command_sqlite_query_item_response_t));
    for (uint8_t i = 0; i < query_response.dataNum; i++) {
      switch (query_response.inquiredData[i].field) {
      case 4: {
        memset(temp, 0, sizeof(temp));
        memset(local_devid, 0, sizeof(local_devid));
        snprintf(temp, sizeof(temp) - 1, "%s/%s", clientID,
                 query_response.inquiredData[i].data.data_char);
        snprintf(local_devid, sizeof(local_devid) - 1, "%s",
                 query_response.inquiredData[i].data.data_char);
      } break;
      default:
        break;
      }
    }
    hash = calculate_config_hash_from_db(&query_response, clientID);
  hash_upload:
    LOG_WARN(OUTPOINT, "Hash: %d\r\n", hash);
    memset((void *)&SKF_BullGateway_tx, 0, sizeof(SKF_BullGateway_tx));
    SKF_BullGateway_tx._messages.config_hash_upload.config_hash_value = hash;
    SKF_BullGateway_tx._messages.config_hash_upload.product = product;
    memset(local_topic, 0, sizeof(local_topic));
    COINFIG_MQTT_PUBLISH_CONFIG_TOPIC(local_topic, SENSOR_NAME, temp);
    Simple_upload(SKFChina_App_AppMessage_config_hash_upload_tag,
                  SKF_BullGateway_tx, local_topic, local_devid);
  }
}

static void construct_topic(char *clientID) {
  char temp[100] = {0};
  for (uint8_t i = 0; i < SUB_TOPIC_NUM; i++) {
    subtopicptr[i] = subtopic[i];
    // subtopicqos[i] = mqtt_qos_one;
    subtopicqos[i] = mqtt_qos_two;
  }
  COINFIG_MQTT_SBUSCRIBE_DATA_TOPIC(subtopic[0], GATAWAY_NAME, clientID)
  COINFIG_MQTT_SBUSCRIBE_FUOTA_TOPIC(subtopic[1], GATAWAY_NAME, clientID)
  COINFIG_MQTT_SBUSCRIBE_DEBUG_TOPIC(subtopic[2], GATAWAY_NAME, clientID)
  COINFIG_MQTT_SBUSCRIBE_CONFIG_TOPIC(subtopic[3], GATAWAY_NAME, clientID);
  snprintf(temp, sizeof(temp) - 1, "%s/#", clientID);
  COINFIG_MQTT_SBUSCRIBE_CONFIG_TOPIC(subtopic[4], SENSOR_NAME, temp);
  COINFIG_MQTT_SBUSCRIBE_DATA_TOPIC(subtopic[5], SENSOR_NAME, temp)
  COINFIG_MQTT_SBUSCRIBE_FUOTA_TOPIC(subtopic[6], SENSOR_NAME, temp)
  COINFIG_MQTT_SBUSCRIBE_DEBUG_TOPIC(subtopic[7], SENSOR_NAME, temp)
}
